## firmware/components/display/Kconfig
```kconfig
menu "TouchDeck perf tools (test builds only)"

    config TD_PERF_TOOLS
        bool "Build the perf measurement commands"
        default n
        select FREERTOS_GENERATE_RUN_TIME_STATS
        select FREERTOS_VTASKLIST_INCLUDE_COREID
        help
            Adds `perf info`, `perf window`, `perf tap`, `perf mem`, `perf cpu`, `perf fb`, `perf invalidate`,
            `perf stall`, `perf memtest`, `perf membw` and `perf temp` to the console and gives `perf fps` panel,
            render, copy and CPU figures. It wraps two esp_lcd calls at link time, turns on FreeRTOS run-time stats
            and never formats a storage volume that will not mount, so it is for test builds only. Build it from
            firmware/perf/tools.defaults into a build directory of its own, never into the committed sdkconfig. Off,
            the firmware compiles to the same code as without it.

    config TD_PERF_VARIANT
        string "Build name that perf info reports"
        depends on TD_PERF_TOOLS
        default "baseline"
        help
            Names the build under test, so a bench can prove which build is flashed. A defaults file listed after
            firmware/perf/tools.defaults sets it.

endmenu

menu "TouchDeck display"

    config TD_PAY_COPY_DEBT
        bool "Bring lagging frame buffers up to date while LVGL is idle"
        default y
        help
            In the adapter's triple-partial mode a refresh that redraws at least a quarter of the screen, such as a
            page slide's frame, leaves the two other frame buffers behind, and each of the next two refreshes copies
            that area into one of them, about 60 ms for the whole screen. With this on, 120 ms after the last such
            refresh, and only while no area waits to be drawn, no animation runs and no pointer is pressed, LVGL
            redraws one unchanged pixel twice, so those copies happen before the next touch and not in its refresh.
            The pixels on the panel stay the same. Off, the next refreshes pay the copies, so the first tap after a
            page slide waits for them.

    config TD_LV_TICK_CB
        bool "Read LVGL's clock from esp_timer instead of a 1 ms tick timer"
        default y
        help
            LVGL reads its millisecond clock from esp_timer_get_time() through lv_tick_set_cb(), and the adapter's
            tick timer, which otherwise wakes the esp_timer task every millisecond to call lv_tick_inc(), gets the
            longest period the adapter accepts, about 71.6 minutes. Off, the adapter's 1 ms timer drives the clock.

    config TD_LAZY_SNAPSHOT_BUF
        bool "Allocate the screenshot buffer only while a screenshot runs"
        default y
        help
            The 1228800-byte PSRAM buffer that `screenshot` renders into is allocated when a screenshot or
            `perf fb check` asks for it and freed when that is done, instead of living from boot. A snapshot job that
            is still queued after its request timed out frees the buffer itself when it ends. Off, the buffer is
            allocated at boot and kept.

endmenu
```

## firmware/components/keys/Kconfig
```kconfig
menu "TouchDeck keys"

    config TD_LAZY_KEY_RECORD
        bool "Allocate the key record only when it first starts"
        default y
        help
            The 2048-report key record, 40960 bytes of PSRAM, is allocated by the first `keys record start` and kept
            until the next reboot, instead of at boot. Before that, `keys record dump` answers with a count of 0. Off,
            the record is allocated at boot.

endmenu
```

## firmware/components/td_link/Kconfig
```kconfig
menu "TouchDeck animation contract"
    config TD_GIF_CAPS
        bool "Advertise proposed GIF capabilities (contract tests only)"
        default n
        help
            Contract test switch. Production must leave this disabled until
            GIF validation, playback and the combined board proof are complete.
endmenu
```

## firmware/components/td_radio/Kconfig
```kconfig
menu "TouchDeck radio build"

    # No prompt: the option is on exactly when this component is in the build, which only -DTD_RADIO_BUILD=1 does.
    config TD_RADIO_BUILD
        bool
        default y
        help
            Set in the radio build, which has Wi-Fi, lwIP and NimBLE. The normal build does not have this
            component, so the option does not exist there, and the radio guards fail any normal build that has it.

    config TD_RADIO_INTERNAL_FLOOR
        int "Internal RAM the radio build keeps free in steady state, in bytes"
        range 24576 131072
        default 24576
        help
            The display, the render tasks and the perf task need internal RAM. With the Wi-Fi station started, the
            radio build logs an error when less than this is free once it reaches steady state, and `radio state`
            reports floor_ok false. It also reports floor_ok false while the station is not started. The radio
            guard fails a build that sets it below 24576.

    config TD_RADIO_STEADY_MS
        int "Time from radio start to the steady-state heap report, in milliseconds"
        range 1000 600000
        default 30000

endmenu
```

## firmware/components/ui/Kconfig
```kconfig
menu "TouchDeck UI"

    config TD_UI_SKIP_NOOP_SETS
        bool "Skip unchanged label sets in widget and dashboard redraws"
        default y
        help
            When an app sends a widget or dashboard value, the redraw sets every label's text, and a widget's text
            opacity, even when nothing changed, and each such set redraws the label. With this on, a set runs only
            when the label would change. The screen shows the same pixels either way, with fewer redrawn frames. Off,
            every set runs.

endmenu
```

## firmware/test_app/sdkconfig.defaults
```kconfig
CONFIG_IDF_TARGET="esp32s3"

CONFIG_ESPTOOLPY_FLASHSIZE_16MB=y
CONFIG_PARTITION_TABLE_CUSTOM=y
CONFIG_PARTITION_TABLE_CUSTOM_FILENAME="../partitions.csv"

CONFIG_ESP_CONSOLE_USB_SERIAL_JTAG=y

CONFIG_COMPILER_OPTIMIZATION_SIZE=y

CONFIG_SPIRAM=y
CONFIG_SPIRAM_MODE_OCT=y
CONFIG_SPIRAM_SPEED_80M=y
CONFIG_SPIRAM_MEMTEST=n

# Link identity tests also link the UI and display components.
CONFIG_LV_USE_SNAPSHOT=y
CONFIG_LV_FONT_MONTSERRAT_32=y
CONFIG_LV_FONT_MONTSERRAT_48=y
```
